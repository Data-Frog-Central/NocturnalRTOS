## components/applications/apps-phobos/Kconfig
```kconfig
menuconfig BR2_PACKAGE_APPS_PHOBOS
	bool "phobos"
	select BR2_PACKAGE_PREBUILTS_LIBGE
	select BR2_PACKAGE_LIBRETRO_COMMON
	select BR2_PACKAGE_ARGENT_LOADER
	#select BR2_PACKAGE_LIBLVGL

if BR2_PACKAGE_APPS_PHOBOS
source "source/Kconfig"
endif
```

## components/argent_loader/Kconfig
```kconfig
config BR2_PACKAGE_ARGENT_LOADER
    bool "argent_loader"
    default n
    help
        External app/Libretro core loading library.
```

## components/bluetooth/ac6955f/Kconfig
```kconfig
config BR2_PACKAGE_AC6955F
	bool "BT AC6955F"
	help
	  Bluetooth ac6955f module api

if BR2_PACKAGE_AC6955F
choice
	prompt "AC6955F select"
    default BR2_PACKAGE_AC6955F_RT
	config BR2_PACKAGE_AC6955F_RT
	bool "BT AC6955F RT"
	help
		Bluetooth ac6955f module api

	config BR2_PACKAGE_AC6955F_GX
	bool "BT AC6955F GX"
	help
		Bluetooth ac6955f gx module api

	config BR2_PACKAGE_AC6956C_GX
	bool "BT AC6956C GX"
	help
		Bluetooth AC6956C gx module api
endchoice
endif
```

## components/kernel/source/drivers/Kconfig
```kconfig
menu "Drivers"

menuconfig CONFIG_DRV_UART
        bool "Uart driver"
        default y

if CONFIG_DRV_UART
source "uart/Kconfig"
endif

menuconfig CONFIG_DRV_VIRTUART
        bool "Virtual uart driver"
        default y

if CONFIG_DRV_VIRTUART
source "virtuart/Kconfig"
endif

menuconfig CONFIG_DRV_FILEUART
        bool "File uart driver"
        default n

if CONFIG_DRV_FILEUART
source "fileuart/Kconfig"
endif

config CONFIG_DRV_DUMMYUART
        bool "Dummy uart driver"
        default y

config CONFIG_DRV_DEVNULL
        bool "Enable /dev/null"
        default y

config CONFIG_DRV_DEVZERO
        bool "Enable /dev/zero"
        default n

config CONFIG_DRV_SOFTIRQ
        bool "Softirq support"
        default n

menuconfig CONFIG_DRV_LNXDRIVER
        bool "Lnx support"
        default n

if CONFIG_DRV_LNXDRIVER
config CONFIG_SCHED_LNXWORKSTACKSIZE
	hex "Default lnx work stack size in uint32_t"
	default 0x1000

config CONFIG_SCHED_SOFTIRQD_HI_PRIORITY
	int "Default lnx softirqd hi task priority"
	default CONFIG_TASK_CRITICAL_PRIORITY

menuconfig CONFIG_SCHED_SOFTIRQD_HI_RESCHED
	bool "Enable softirqd hi task resched"
	default y

if CONFIG_SCHED_SOFTIRQD_HI_RESCHED
config CONFIG_SCHED_SOFTIRQD_HI_RESCHED_PRIORITY
	int "Default lnx softirqd hi task resched priority"
	default CONFIG_TASK_CRITICAL_PRIORITY
endif

config CONFIG_SCHED_SOFTIRQD_PRIORITY
	int "Default lnx softirqd task priority"
	default CONFIG_TASK_CRITICAL_PRIORITY

menuconfig CONFIG_SCHED_SOFTIRQD_RESCHED
	bool "Enable softirqd task resched"
	default y

if CONFIG_SCHED_SOFTIRQD_RESCHED
config CONFIG_SCHED_SOFTIRQD_RESCHED_PRIORITY
	int "Default lnx softirqd task resched priority"
	default CONFIG_TASK_CRITICAL_PRIORITY
endif

config CONFIG_NET_RX_SOFTIRQ_IN_TASK_ONLY
	bool "net rx softirq process in task only"
	default n

config CONFIG_NET_TX_SOFTIRQ_IN_TASK_ONLY
	bool "net tx softirq process in task only"
	default n

config CONFIG_TASKLET_SOFTIRQ2_IN_TASK_ONLY
	bool "tasklet softirq process in task only"
	default n
endif

menuconfig CONFIG_DRV_WQUEUE
        bool "Workqueue support"
        default y

if CONFIG_DRV_WQUEUE
source "wqueue/Kconfig"
endif

menuconfig CONFIG_DRV_AMPRPC
        bool "AMP RPC support"
	select CONFIG_SCHED_RPCWORK
	select CONFIG_SCHED_HPWORK
	select CONFIG_WQUEUE_NOTIFIER
	depends on CONFIG_SOC_HC16XX
        default n

if CONFIG_DRV_AMPRPC
source "amprpc/Kconfig"
endif

config CONFIG_DRVR_RAMDISK
	bool "Ramdisk"
	default n

config CONFIG_DRVR_MKRD
	bool "RAM disk wrapper (mkrd)"
	default n
	---help---
		Build the mkrd() function which serves as a wrapper to simplify
		creation of RAM disks.  If the boardctrl() interface is enabled,
		the selecting this option will also enable the BOARDIOC_MKRD
		command that will support creation of RAM disks from applications.

source "bch/Kconfig"

source "mtd/Kconfig"

source "pipes/Kconfig"

menu "Buffering"

config CONFIG_DRVR_WRITEBUFFER
	bool "Enable write buffer support"
	default n
	---help---
		Enable generic write buffering support that can be used by a variety
		of drivers.

if CONFIG_DRVR_WRITEBUFFER

config CONFIG_DRVR_WRDELAY
	int "Write flush delay"
	default 350
	---help---
		If there is no write activity for this configured amount of time,
		then the contents will be automatically flushed to the media.  This
		reduces the likelihood that data will be stuck in the write buffer
		at the time of power down.

endif # CONFIG_DRVR_WRITEBUFFER

config CONFIG_DRVR_READAHEAD
	bool "Enable read-ahead buffer support"
	default n
	---help---
		Enable generic read-ahead buffering support that can be used by a
		variety of drivers.

if CONFIG_DRVR_WRITEBUFFER || CONFIG_DRVR_READAHEAD

config CONFIG_DRVR_READBYTES
	bool "Support byte read method"
	default y if CONFIG_MTD_BYTE_WRITE
	default n if !CONFIG_MTD_BYTE_WRITE

config CONFIG_DRVR_REMOVABLE
	bool "Support removable media"
	default n

config CONFIG_DRVR_INVALIDATE
	bool "Support cache invalidation"
	default n

endif # CONFIG_DRVR_WRITEBUFFER || CONFIG_DRVR_READAHEAD

endmenu # Buffering

config CONFIG_DEV_MMZ
	bool "mmz dev"
	default y

menuconfig CONFIG_DRV_VIDEO
	bool "video"
	default n

if CONFIG_DRV_VIDEO
source "video/Kconfig"
endif


config CONFIG_DRV_PINMUX
	bool "pinmux"
	default y

config CONFIG_DRV_GPIO
	bool "gpio"
	default y

source "av/Kconfig"

config CONFIG_DRV_POK
	bool "pok Support"
	default n

menuconfig CONFIG_DRV_INPUT
	bool "input event"
	default y

if CONFIG_DRV_INPUT
source "input/Kconfig"
endif

menuconfig CONFIG_DRV_SPI
	bool "spi support"
	default y

if CONFIG_DRV_SPI
source "spi/Kconfig"
endif

config CONFIG_DRV_LVDS
	bool "lvds"
	depends on CONFIG_SOC_HC16XX
	default n

config CONFIG_DRV_RGB
	bool "rgb"
	depends on CONFIG_SOC_HC15XX
	default n

config CONFIG_DRV_MIPI
	bool "mipi"
	depends on CONFIG_SOC_HC16XX
	default y

source "i2c/Kconfig"

source "pwm/Kconfig"

config CONFIG_DRV_NBDBG
	bool "NB debug"
	default n

menuconfig CONFIG_DRV_APLATFORM
	bool "audio platform support"
	default y

if CONFIG_DRV_APLATFORM
source "aplatform/Kconfig"
endif

menuconfig CONFIG_DRV_WDT
	bool "watchdog"
	default n

if CONFIG_DRV_WDT
	source "watchdog/Kconfig"
endif

config CONFIG_DRV_PERSISTENTMEM
	bool "persistent memory"
	select CONFIG_LIB_CRC
	select CONFIG_MTD_BYTE_WRITE
	default y

config CONFIG_DRV_HWSPINLOCK
        bool "hwspinlock"
        default n

menuconfig CONFIG_DRV_KSHM
	bool "kshm driver"
	select CONFIG_DRV_HWSPINLOCK
	default y

if CONFIG_DRV_KSHM
config CONFIG_DRV_KSHM_FOR_DUALCORE
	bool "kshm for dualcore"
	default n
endif

config CONFIG_DRV_HCGE
	bool "hcge driver"
	default n

menuconfig CONFIG_DRV_STANDBY
        bool "standby driver"
        default n

if CONFIG_DRV_STANDBY
source "standby/Kconfig"
endif

menuconfig CONFIG_DRV_DVP
	bool "dvp driver"
	default n

if CONFIG_DRV_DVP
source "dvp/Kconfig"
endif

source "crypto/Kconfig"


menuconfig CONFIG_USB_VENDOR
	bool "USB vendor setting"
	default n
	---help---
		USB vendor setting for HICHIP SOC

	if CONFIG_USB_VENDOR
		config CONFIG_USB_PHY_SETTING
		bool "enable USB PHY setting"
		default n

		config CONFIG_USB_GADGET_VBUS_DETECT
		bool "detect usb#0 gadget connect/disconnect by VBUS"
		default n
		---help---
			The hardware development board needs to be connected to 
			the VBUS pin, then you can determine whether there is a 
			USB host connection by detecting the VBUS status value.

		menuconfig CONFIG_USB_GADGET_VENDOR
			bool "USB gadget vendor support"
			default n

		if CONFIG_USB_GADGET_VENDOR
			config CONFIG_USB_ZERO
				bool "usb gadget demo: zero"
				default n
		endif

		if CONFIG_USB_GADGET_VENDOR
			config CONFIG_USB_GADGET_HID_VENDOR
				bool "usb gadget demo: hid mouse/keyboard report parameters"
				default n
		endif

		if CONFIG_USB_GADGET_VENDOR
			config BR2_USBGADGETDRIVER_MSC_BUFLEN
				int "usb gadget mass-storage buffer size (uint: KB)"
				depends on BR2_PACKAGE_PREBUILTS_USBGADGETDRIVER_MSC
				range 4 512
				default 16
		endif

		if CONFIG_USB_GADGET_VENDOR
			config BR2_USBGADGETDRIVER_UVC_MAXPACKET
				int "usb gadget uvc : max packet size (uint: Bytes, rang: 1 ~ 1024)"
				depends on BR2_PACKAGE_PREBUILTS_USBGADGETDRIVER_UVC
				range 1 1024
				default 1024
		endif

		
	endif
 
menuconfig CONFIG_DRV_LCD
	bool "lcd driver"
	default n

if CONFIG_DRV_LCD
source "lcd/Kconfig"
endif

menuconfig CONFIG_DRV_RTC
	bool "rtc driver"
	default n

if CONFIG_DRV_RTC
source "rtc/Kconfig"
endif

config CONFIG_HC_NAND
	bool "nand controller"
	depends on CONFIG_SOC_HC16XX
	default n
	
endmenu
```

## components/kernel/source/drivers/dvp/Kconfig
```kconfig
config CONFIG_DVP_RN6752V1
	bool "RN6752V1"
	default n
	
config CONFIG_DVP_RN6752
	bool "RN6752"
	default n	

config CONFIG_DVP_BF3A03
	bool "bf3a03"
	default n

config CONFIG_DVP_GC0328
	bool "gc0328"
	default n		
```

## components/kernel/source/drivers/lcd/Kconfig
```kconfig
config CONFIG_DRV_LCD_DEV
	bool "lcd dev"
	default n

config CONFIG_DRV_LCD_NT35510
	bool "lcd nt35510 support"
	default n

config CONFIG_DRV_LCD_GC9505
	bool "lcd gc9505 support"
	default n

config CONFIG_DRV_LCD_JDI026
	bool "lcd jdi026 support"
	default n

config CONFIG_DRV_LCD_SC5014A
	bool "lcd sc5014 support"
	default n

config CONFIG_DRV_LCD_JD9168
	bool "lcd jd9168 support"
	default n

config CONFIG_DRV_LCD_JD9168V2
	bool "lcd jd9168v2 support"
	default n

config CONFIG_DRV_LCD_ST7789V2
	bool "lcd st7789v2 support"
	default n

config CONFIG_DRV_LCD_N116BGE
	bool "lcd n116bge support"
	default n

config CONFIG_DRV_LCD_ST7265
	bool "lcd st7265 support"
	default n

config CONFIG_DRV_LCD_ST7789V3
	bool "lcd st7789v3"
	default n

config CONFIG_DRV_ECX336CN
	bool "lcd ecx336cn"
	default n

config CONFIG_DRV_ST7701S
	bool "lcd st7701s"
	default n

config CONFIG_DRV_SONY106
	bool "lcd sony106"
	default n

config CONFIG_DRV_LCD_DSI0
	bool "lcd mipi dsi0 init"
	default n
	depends on CONFIG_DRV_MIPI

config CONFIG_DRV_LCD_DSI_JJ101L008
	bool "lcd mipi dsi jj101l008"
	default n
	depends on CONFIG_DRV_MIPI

config CONFIG_DRV_BACKLIGHT
	bool "backlight support"
	default n
```

## components/kernel/source/drivers/standby/Kconfig
```kconfig
choice
        prompt "Mode"
        default CONFIG_CLOSE_IP

        config CONFIG_OUT_HC_SCANCODE
        bool "Debug output hichip scancode"

        config CONFIG_CLOSE_IP
        bool "Enable close ip"
endchoice

if CONFIG_CLOSE_IP

config CONFIG_CLOSE_SIDO
        bool "close sdio"
        default y

config CONFIG_CLOSE_VDAC
        bool "close vdac"
        default y

config CONFIG_CLOSE_LVDS
        bool "close lvds"
        default y

config CONFIG_CLOSE_MIPI
        bool "close mipi"
        default y

config CONFIG_CLOSE_CVBS
        bool "close cvbs"
        default y

config CONFIG_CLOSE_HDRX
        bool "close hdrx"
        default y

config CONFIG_CLOSE_DDR
        bool "close ddr"
        default n
endif
```

## components/libretro_common/Kconfig
```kconfig
config BR2_PACKAGE_LIBRETRO_COMMON
    bool "libretro_common"
    default n
    help
        Libretro common modules.
```
