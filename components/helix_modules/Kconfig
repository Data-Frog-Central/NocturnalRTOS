## components/helix_modules/Kconfig
```kconfig
config BR2_PACKAGE_HELIX_MODULES
    bool "helix_modules"
    default n
    help
        Modular libs ideally designed to work with both Phobos and Deimos.
```

## components/nocturnal_drivers/Kconfig
```kconfig
config BR2_PACKAGE_NOCTURNAL_DRIVERS
    bool "nocturnal_drivers"
    default n
    help
        Audio GFX and Input drivers for NocturnalRTOS.
```

## components/zip/Kconfig
```kconfig
config BR2_PACKAGE_ZIP
    bool "zip"
    default n
    help
        A portable, simple zip library written in C.
```
